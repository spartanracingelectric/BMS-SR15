VERSION "HIPBNYYYYYYYYYYYYYYYYYYYYYYYYYYYYYYYYYYYYY/4/%%%/4/'%**4YYY///"

NS_ :

BS_:

BU_: BMS1000M VCU

BO_ 1536 BMS_Safety_Checker: 1 [CUSTOM_BMS]
 SG_ Pack_High_Volt_Fault : 8|1@1+ (1,0) [0|1] "" Vector__XXX
 SG_ Pack_Low_Volt_Fault : 7|1@1+ (1,0) [0|1] "" Vector__XXX
 SG_ Cell_High_Volt_Fault : 6|1@1+ (1,0) [0|1] "" Vector__XXX
 SG_ Cell_Low_Volt_Fault : 5|1@1+ (1,0) [0|1] "" Vector__XXX
 SG_ Cell_High_Temp_Fault : 4|1@1+ (1,0) [0|1] "" Vector__XXX
